/**
 * @cliArgs --board "/ti/boards/MSP_EXP432P401R" --product "simplelink_msp432p4_sdk@3.40.01.02"
 * @versions {"data":"2020052512","timestamp":"2020052512","tool":"1.5.0+1397","templates":"2020052512"}
 */
const BOOSTXL_BASSENSORS = scripting.addHardware("/ti/boards/boosterpacks/BOOSTXL-BASSENSORS");

/**
 * Import the modules used in this configuration.
 */
const Display  = scripting.addModule("/ti/display/Display");
const Display1 = Display.addInstance();
const GPIO     = scripting.addModule("/ti/drivers/GPIO");
const GPIO1    = GPIO.addInstance();
const GPIO2    = GPIO.addInstance();
const GPIO3    = GPIO.addInstance();
const I2C      = scripting.addModule("/ti/drivers/I2C");
const I2C1     = I2C.addInstance();
const I2C2     = I2C.addInstance();
const RTOS     = scripting.addModule("/ti/drivers/RTOS");

/**
 * Write custom configuration values to the imported modules.
 */
Display1.$name      = "CONFIG_Display_0";
Display1.$hardware  = system.deviceData.board.components.XDS110UART;
Display1.uart.$name = "CONFIG_UART_0";

GPIO1.$hardware = system.deviceData.board.components.LED1_RED;
GPIO1.$name     = "CONFIG_GPIO_LED_0";

GPIO2.$name           = "CONFIG_GPIO_0";
GPIO2.mode            = "Dynamic";
GPIO2.gpioPin.$assign = "boosterpack.11";

GPIO3.$name           = "CONFIG_GPIO_1";
GPIO3.mode            = "Dynamic";
GPIO3.gpioPin.$assign = "boosterpack.31";

I2C1.$name     = "CONFIG_I2C_1";
I2C1.$hardware = BOOSTXL_BASSENSORS.components.BOOSTXL_BASSENSORS_I2C;

I2C2.$name = "CONFIG_I2C_0";

const Power                   = scripting.addModule("/ti/drivers/Power", {}, false);
Power.performanceLevel3.$name = "ti_drivers_power_PowerMSP432PerfLevels0";
Power.performanceLevel2.$name = "ti_drivers_power_PowerMSP432PerfLevels1";
Power.performanceLevel1.$name = "ti_drivers_power_PowerMSP432PerfLevels2";
Power.performanceLevel0.$name = "ti_drivers_power_PowerMSP432PerfLevels3";


/**
 * Pinmux solution for unlocked pins/peripherals. This ensures that minor changes to the automatic solver in a future
 * version of the tool will not impact the pinmux you originally saw.  These lines can be completely deleted in order to
 * re-solve from scratch.
 */
Display1.uart.uart.$suggestSolution       = "EUSCI_A0";
Display1.uart.uart.txPin.$suggestSolution = "P1.3.GPIO/EUSCI_A0_UART.TXD/EUSCI_A0_SPI.SIMO";
Display1.uart.uart.rxPin.$suggestSolution = "P1.2.GPIO/EUSCI_A0_UART.RXD/EUSCI_A0_SPI.SOMI";
GPIO1.gpioPin.$suggestSolution            = "P1.0.GPIO/EUSCI_A0_SPI.STE";
I2C1.i2c.$suggestSolution                 = "EUSCI_B1";
I2C1.i2c.sdaPin.$suggestSolution          = "boosterpack.10";
I2C1.i2c.sclPin.$suggestSolution          = "boosterpack.9";
I2C2.i2c.$suggestSolution                 = "EUSCI_B0";
I2C2.i2c.sdaPin.$suggestSolution          = "boosterpack.15";
I2C2.i2c.sclPin.$suggestSolution          = "boosterpack.14";
RTOS.timer0.resource.$suggestSolution     = "Timer_A0";
